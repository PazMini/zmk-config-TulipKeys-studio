## boards/shields/TulipKeys/Kconfig.defconfig
```kconfig
if SHIELD_TulipKeys_LEFT 

config ZMK_KEYBOARD_NAME
    default "TulipKeys"

config ZMK_SPLIT_ROLE_CENTRAL
    default y

endif

if SHIELD_TulipKeys_LEFT || SHIELD_TulipKeys_RIGHT || SHIELD_TulipKeys_LEFT_PERIPHERAL || SHIELD_TulipKeys_DONGLE_XIAO || SHIELD_TulipKeys_DONGLE_PRO_MICRO

config ZMK_SPLIT
    default y


endif
```

## boards/shields/TulipKeys/Kconfig.shield
```kconfig
config SHIELD_TulipKeys_LEFT
    def_bool $(shields_list_contains,TulipKeys_left)

config SHIELD_TulipKeys_RIGHT
    def_bool $(shields_list_contains,TulipKeys_right)
```
